## mt7921/Kconfig
```kconfig
# SPDX-License-Identifier: BSD-3-Clause-Clear
config STANDALONE_MT7921_COMMON
	tristate
	select STANDALONE_MT792x_LIB
	select WANT_DEV_COREDUMP

config STANDALONE_MT7921U
	tristate "MediaTek Standalone MT7921U (USB) support"
	select STANDALONE_MT792x_USB
	select STANDALONE_MT7921_COMMON
	depends on MAC80211
	depends on USB
	help
	  This adds support for standalone MT7921U 802.11ax 2x2:2SS wireless devices.

	  To compile this driver as a module, choose M here.
```
